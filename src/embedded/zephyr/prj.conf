## prj.conf
```kconfig
CONFIG_SERIAL=y
CONFIG_GPIO=y

CONFIG_SYSTEM_WORKQUEUE_STACK_SIZE=2048

CONFIG_BT=y
CONFIG_LOG=y
CONFIG_BT_SMP=y
CONFIG_BT_SIGNING=y
CONFIG_BT_PERIPHERAL=n
CONFIG_BT_CENTRAL=y
CONFIG_BT_GATT_CLIENT=y
CONFIG_BT_DIS=y
CONFIG_BT_BAS=y
CONFIG_BT_ATT_PREPARE_COUNT=5
CONFIG_BT_PRIVACY=y
CONFIG_BT_DEVICE_NAME="MAGIC Peripheral"
CONFIG_BT_DEVICE_APPEARANCE=833
CONFIG_BT_DEVICE_NAME_DYNAMIC=y
CONFIG_BT_DEVICE_NAME_MAX=65

CONFIG_BT_KEYS_OVERWRITE_OLDEST=y
CONFIG_BT_SETTINGS=y
CONFIG_FLASH=y
CONFIG_FLASH_PAGE_LAYOUT=y
CONFIG_FLASH_MAP=y
CONFIG_NVS=y
CONFIG_SETTINGS=y

CONFIG_NEWLIB_LIBC=y
CONFIG_LED=y
```

## src/main.cpp
```c
#include "bluetooth.h"
//#include "foo.h"
#include "gpio.h"
#include "test.h"
#include "sessionless.hpp"

#include <zephyr/kernel.h>
#include <stdio.h>

int main()
{
//    if (!gpio::initialize())
    if(false)
    {
        printf("Error: Failed to init GPIO\n");
        return -1;
    }

    if (!bluetooth::initialize())
    {
        printf("Error: Failed to init Bluetooth\n");
        return -1;
    }

    int previous_state = 0;

    const struct gpio::led_value red = gpio::make_led_value(1, 0, 0);
    const struct gpio::led_value green = gpio::make_led_value(0, 1, 0);
    const struct gpio::led_value blue = gpio::make_led_value(0, 0, 1);

    static constexpr int32_t SLEEP_TIME_MS = 50;

    while (true)
/*    {
    //    bluetooth::bas_notify();

        const int button_state = gpio::get_button();

        // If no error reading button
        if (button_state >= 0)
        {
            // Display button state on LED
//            gpio::set_led(button_state);

            // If button pressed after being released
            if (button_state && button_state != previous_state)
            {

                // TODO send Magic BLE packet

                Keys keys;
                if (!sessionless::generateKeys(keys))
                {
                    gpio::set_led(0);
                    continue;
                }

                const char *msg = "Here is a message";
                unsigned char signature[SIGNATURE_SIZE_BYTES];                
                if (!sessionless::sign((unsigned char *)msg, sizeof(msg), keys.privateKey, signature))
                {
                    gpio::set_led(0);
                    continue;
                }

                if (!sessionless::verifySignature(signature, keys.publicKey, 
                                                  (unsigned char *)msg, sizeof(msg)))
                {
                    gpio::set_led(0);
                    continue;
                }

                // Verified
                gpio::set_led(1);
            }
            previous_state = button_state;
        }

        k_msleep(SLEEP_TIME_MS);
    }*/

    while(true)
    {
        gpio::set_led(1);
        k_msleep(1000);
        int foo;
        foo = test::test();
        bool scanning;
	scanning = bluetooth::start_scan();
	if(!scanning) {
            gpio::display_led_values(red, red, red);
	    break;
	}
    }

    return 0;
}
```

## src/gpio.cpp
```c
#include "gpio.h"
#include <zephyr/drivers/gpio.h>
#include <stdio.h>
#include <zephyr/kernel.h>
//#include <chrono>
//#include <thread>

static const struct gpio_dt_spec led0 = GPIO_DT_SPEC_GET_OR(DT_ALIAS(led0), gpios, {0});
static const struct gpio_dt_spec button = GPIO_DT_SPEC_GET_OR(DT_ALIAS(sw0), gpios, {0});

namespace gpio
{
//    using namespace std::this_thread; 
//    using namespace std::chrono;

    bool configure_gpio(const struct gpio_dt_spec *spec, gpio_flags_t flags)
    {
        if (!gpio_is_ready_dt(spec))
        {
            printf("Error: GPIO pin not ready\n");
            return false;
        }

        const int ret = gpio_pin_configure_dt(spec, flags);
        if (ret < 0)
        {
            printf("Error: Failed to configure GPIO pin\n");
            return false;
        }

        return true;
    }

    bool initialize()
    {
        gpio_dt_spec leds[] = {led0};
        for (auto &led : leds)
        {
            if (!configure_gpio(&led, GPIO_OUTPUT_INACTIVE))
            {
                printf("Error: Failed to configure LEDs\n");
                return false;
            }
        }

        if (!configure_gpio(&button, GPIO_INPUT))
        {
            printf("Error: Failed to configure button\n");
            return false;
        }

        return true;
    }

    int get_button()
    {
        return gpio_pin_get_dt(&button);
    }

    void set_led(const int state)
    {
        gpio_dt_spec leds[] = {led0};
        for (auto &led : leds)
        {
            gpio_pin_set_dt(&led, state);
        }
        //gpio_pin_set_dt(&led0, state);
    }

    void set_rgb_led(const int r, const int g, const int b)
    {
    //     gpio_pin_set_dt(&led1_r, r);
    //     gpio_pin_set_dt(&led1_g, g);
    //     gpio_pin_set_dt(&led1_b, b);
    } 

    led_value make_led_value(const int r, const int g, const int b)
    {
         struct led_value value;
    //     value.r = r;
    //     value.g = g;
    //     value.b = b;
         value.r = 0;
         value.g = 0;
         value.b = 0;
         return value;
    }

    void display_led_value(const led_value value)
    {
    //     set_rgb_led(0, 0, 0);
    //     //sleep_for(milliseconds(250));
    //     k_busy_wait(500000);
    //     set_rgb_led(value.r, value.g, value.b);
    //    // sleep_for(milliseconds(250));
    //     k_busy_wait(500000);
    }

    void display_led_values(const led_value first, const led_value second, const led_value third) 
    {
    //     display_led_value(first);
    //     display_led_value(second);
    //     display_led_value(third);
    }

    void display_error() 
    {
       

    }
}
```

## src/gpio.h
```c
#pragma once

namespace gpio
{

    struct led_value
    {
        int r;
        int g; 
        int b;
    };

    led_value make_led_value(const int r, const int g, const int b);

    bool initialize();
    int get_button();
    void display_led_value(led_value);
    void display_led_values(const led_value first, const led_value second, const led_value third);
    void set_led(const int state);
    void set_rgb_led(const int r, const int g, const int b);
}
```

## src/test.cpp
```c
#include <zephyr/device.h>
#include <zephyr/devicetree.h>
#include <zephyr/drivers/gpio.h>
#include <errno.h>
#include <zephyr/drivers/led.h>
#include <zephyr/sys/util.h>
#include <zephyr/kernel.h>

//#define LED_PWM_NODE_ID	 DT_COMPAT_GET_ANY_STATUS_OKAY(pwm_leds)

/*const char *led_label[] = {
	DT_FOREACH_CHILD_SEP_VARGS(LED_PWM_NODE_ID, DT_PROP_OR, (,), label, NULL)
};*/

const int num_leds = 3;

static const struct gpio_dt_spec led0 = GPIO_DT_SPEC_GET_OR(DT_ALIAS(led0), gpios, {0});
//static const struct gpio_dt_spec led_red   = GPIO_DT_SPEC_GET(DT_ALIAS(ledred), gpios);
//static const struct gpio_dt_spec led_green = GPIO_DT_SPEC_GET(DT_ALIAS(ledgreen), gpios);
//static const struct gpio_dt_spec led_blue  = GPIO_DT_SPEC_GET(DT_ALIAS(ledblue), gpios);





namespace test
{
    int test()
    {
        //const struct device *led_pwm;
	//uint8_t led;

	//led_pwm = DEVICE_DT_GET(LED_PWM_NODE_ID);
//	if (!device_is_ready(led_pwm)) {
//		LOG_ERR("Device %s is not ready", led_pwm->name);
//		return 0;
//	}

        bool foo = true;
        int led = 0;
       
        do {
	    for (led = 0; led < num_leds; led++) {
/*                gpio_pin_toggle_dt(&led_red);
		//led_on(led_pwm, led);
                k_msleep(1000);
                gpio_pin_toggle_dt(&led_green);
                k_msleep(1000);
                //led_off(led_pwm, led);
                gpio_pin_toggle_dt(&led_blue);
                k_msleep(1000);
*/
                gpio_pin_toggle_dt(&led0);
                k_msleep(1000);
                gpio_pin_toggle_dt(&led0);
                k_msleep(1000);
	    }
            foo = false;
	} while (foo);
        return 1;
    }
}
```

## src/test.h
```c
#pragma once

namespace test
{
    int test();
}
```
